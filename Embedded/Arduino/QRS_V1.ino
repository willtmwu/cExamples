#include "arm_math.h"
#include "ADC.h"

#define DEBUG 
uint32_t qrs_test_counter = 0;
#define QRS_TEST_NUM_SAMPLES  5413
float32_t qrs_test_data[] = {825,825,825,825,825,825,825,821,827,827,830,829,830,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851,851};

#define QRS_IN_PIN    A1
#define QRS_IN_ADC    ADC_0
#define QRS_OUT_PIN   A14
#define QRS_DECT_PIN  A7
#define QRS_FREQ 200 /* Sampling frequency */
int QRS_LOOP_DELAY = 1000/QRS_FREQ; /* Delay in ms per ADC read*/
#define QRS_SAMPLING_WINDOW 4000 /* Buffer window in ms*/
#define QRS_BUFFER_SIZE 50 /* Buffer size = sampling_window/sampling_period */

ADC *adc = new ADC();
float32_t single_read = 0;
float32_t adc_buffer[QRS_BUFFER_SIZE];

bool qrs_detected = false;
float32_t lp_filter[] = {1,2,3,4,5,6,5,4,3,2,
                            1,0,0};
uint32_t lp_filter_len = 13;
float32_t hp_filter[] = {-1,-1,-1,-1,-1,-1,-1,-1,-1,-1,
                             -1,-1,-1,-1,-1,-1,31,-1,-1,-1,
                             -1,-1,-1,-1,-1,-1,-1,-1,-1,-1,
                             -1,-1,0};
uint32_t hp_filter_len = 33;
float32_t drv_filter[] = {-0.125, -0.25, 0, 0.25, 0.125};
uint32_t drv_filter_len = 5;

#define MAX_RES_SIZE 82 /* QRS_BUFFER_SIZE+hpf_len-1 */
float32_t conv_res_bufferA[MAX_RES_SIZE];
float32_t conv_res_bufferB[MAX_RES_SIZE];
float32_t conv_res_bufferC[MAX_RES_SIZE];

float32_t thr_sig_avg = 0; /* Threshold signal average */
float32_t thr_noise_avg = 0; /*  Threshold noise average */
float32_t run_sig_avg = 0; /* Running average */

void setup(){

  pinMode(QRS_IN_PIN, INPUT);
  pinMode(QRS_OUT_PIN, OUTPUT);
  pinMode(QRS_DECT_PIN, OUTPUT);
  pinMode(LED_BUILTIN, OUTPUT);
  analogWriteResolution(12);
  analogReadResolution(12);
  //setup_adc();

  Serial.begin(512000);
  delay(500);
}

void loop(){
  single_read = read_qrs_val();
  /*Serial.print(200);
  Serial.print(",");
  //Serial.print(adc->analogReadContinuous(QRS_IN_ADC), DEC);
  Serial.print(analogRead(A0), DEC);
  Serial.println("");
  delay(5);*/
 
  shift_buffer(single_read, adc_buffer, QRS_BUFFER_SIZE);  
  process_signal(adc_buffer, QRS_BUFFER_SIZE);

   /* Debug to ensure program is running */
   //digitalWriteFast(LED_BUILTIN, !digitalReadFast(LED_BUILTIN));
}

void print_qrs_configurations(void){
  Serial.println("__QRS Configurations__");
}

void setup_adc(){
  adc->setReference(ADC_REF_3V3);
  adc->setAveraging(32);
  adc->setResolution(16);
  adc->setConversionSpeed(ADC_HIGH_SPEED);
  adc->setSamplingSpeed(ADC_HIGH_SPEED);
  adc->startContinuous(QRS_IN_PIN, QRS_IN_ADC);
}

float32_t read_qrs_val(){
  /*qrs_test_counter++;
  qrs_test_counter = qrs_test_counter%QRS_TEST_NUM_SAMPLES;
  return qrs_test_data[qrs_test_counter];*/
  
  //return (float32_t)adc->analogReadContinuous(QRS_IN_ADC);
  return (float32_t) analogRead(QRS_IN_PIN);
}

/* VERIFIED Sampling [New -> Old] Data*/
void shift_buffer(float32_t new_value, float32_t* sampling_buffer, uint32_t buffer_size){
  for(int i=(buffer_size-1);i>0;i--){
    sampling_buffer[i] = sampling_buffer[i-1];
  }
  sampling_buffer[0] = new_value;
}



void process_signal(float32_t* sampling_buffer, uint32_t buffer_len){
  clear_all_conv_buffers();

  /* Low Pass Filter */
  arm_conv_f32(sampling_buffer,buffer_len,
                  lp_filter,lp_filter_len,
                  conv_res_bufferA);
  normalise_data(conv_res_bufferA,MAX_RES_SIZE);

  /* High Pass Filter */
  arm_conv_f32(conv_res_bufferA+6,buffer_len, 
                  hp_filter,hp_filter_len,
                  conv_res_bufferB); 
  normalise_data(conv_res_bufferB,MAX_RES_SIZE);

  /* Derivative Pass Filter */
  arm_conv_f32(conv_res_bufferB+16,buffer_len,
                  drv_filter,drv_filter_len,
                  conv_res_bufferC);
  normalise_data(conv_res_bufferC,MAX_RES_SIZE);

  /* Square the result */
  for (int i = 0; i < MAX_RES_SIZE; i++) {
    conv_res_bufferC[i] = conv_res_bufferC[i]*conv_res_bufferC[i];
  }

  /* Average or set thresholds */
  float32_t mean_val = 0, max_val = 0, alpha = 0.1;
  uint32_t index;
  //arm_max_f32(conv_res_bufferC+2, buffer_len, &max_val, &index);
  max_val = conv_res_bufferC[5];
  run_sig_avg = (alpha * conv_res_bufferC[5]) + (1.0 - alpha) * run_sig_avg;
  
  arm_mean_f32(conv_res_bufferC+2+10, buffer_len-10, &mean_val);
  
  if (max_val>(6/1000)) {
    thr_sig_avg = (thr_sig_avg + 0.25*max_val)/2;  
    
  }
  thr_noise_avg = (thr_noise_avg + 2*mean_val)/2;  

  Serial.print(200);
  Serial.print(",");
  Serial.print(sampling_buffer[0], DEC);
  Serial.print(",");
  Serial.print(conv_res_bufferC[5]*100000, DEC);
  Serial.print(",");
  Serial.print(400, DEC);

  analogWrite(QRS_OUT_PIN, conv_res_bufferC[5]*100000);    
  if (conv_res_bufferC[5]*100000 > 400) {
    Serial.print(",");
    Serial.print("True");
    
    //analogWrite(QRS_DECT_PIN, HIGH);   
    digitalWriteFast(LED_BUILTIN, HIGH);
    
   } else {
    //analogWrite(QRS_DECT_PIN, LOW);
    digitalWriteFast(LED_BUILTIN, LOW);
   }
  
  Serial.println("");
}

void normalise_data(float32_t* data, uint32_t len){
  float32_t inv = 0;
  float32_t max_value = 1;
  for (int i = 0; i < len; i++){
    if (data[i] < 0) {
       inv = -1*data[i];
    } else {
       inv = data[i];
    }

    if (inv>max_value) {
      max_value = inv;
    }
  }

  for (int i = 0; i < len; i++){
   data[i] = data[i]/max_value;
  }
}

void clear_all_conv_buffers(){
  for (int i = 0; i<MAX_RES_SIZE;i++) {
     conv_res_bufferA[i] = 0;
     conv_res_bufferB[i] = 0;
     conv_res_bufferC[i] = 0;
  }  
}











